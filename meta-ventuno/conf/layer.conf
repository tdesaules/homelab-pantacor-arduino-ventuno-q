## meta-ventuno/conf/layer.conf
```bitbake
BBPATH .= ":${LAYERDIR}"
BBFILES += "${LAYERDIR}/recipes-*/*/*.bb ${LAYERDIR}/recipes-*/*/*.bbappend"
BBFILE_COLLECTIONS += "ventuno"
BBFILE_PATTERN_ventuno = "^${LAYERDIR}/"
BBFILE_PRIORITY_ventuno = "10"
LAYERSERIES_COMPAT_ventuno = "scarthgap"
LAYERDEPENDS_ventuno = "core"
```
